## huananzhi/BD4/Kconfig
```kconfig
if BOARD_HUANANZHI_BD4

config BOARD_SPECIFIC_OPTIONS
	def_bool y
	select BOARD_ROMSIZE_KB_16384
	select CPU_INTEL_HASWELL
	select HAVE_ACPI_RESUME
	select HAVE_ACPI_TABLES
	select NORTHBRIDGE_INTEL_HASWELL
	select SERIRQ_CONTINUOUS_MODE
	select SOUTHBRIDGE_INTEL_LYNXPOINT
	select SUPERIO_NUVOTON_NCT6779D

config CBFS_SIZE
	default 0x800000

config MAINBOARD_DIR
	string
	default "huananzhi/BD4"

config MAINBOARD_PART_NUMBER
	string
	default "X99-BD4"

config MAX_CPUS
	int
	default 44

config USBDEBUG_HCD_INDEX # FIXME: check this
	int
	default 2
endif
```

## huananzhi/Kconfig
```kconfig
## SPDX-License-Identifier: GPL-2.0-only

if VENDOR_HUANANZHI

choice
	prompt "Mainboard model"

source "src/mainboard/huananzhi/*/Kconfig.name"

endchoice

source "src/mainboard/huananzhi/*/Kconfig"

config MAINBOARD_VENDOR
	string
	default "HUANANZHI"

endif # VENDOR_HUANANZHI
```

## huananzhi/QD4/Kconfig
```kconfig
if BOARD_HUANANZHI_QD4

config BOARD_SPECIFIC_OPTIONS
	def_bool y
	select BOARD_ROMSIZE_KB_16384
	select HAVE_ACPI_RESUME
	select HAVE_ACPI_TABLES
	select NORTHBRIDGE_INTEL_HASWELL
	select SERIRQ_CONTINUOUS_MODE
	select SOUTHBRIDGE_INTEL_LYNXPOINT

config MAINBOARD_DIR
	string
	default "huananzhi/QD4"

config MAINBOARD_PART_NUMBER
	string
	default ""

config USBDEBUG_HCD_INDEX # FIXME: check this
	int
	default 2
endif
```

## huananzhi/x99-qd4/Kconfig
```kconfig
# SPDX-License-Identifier: GPL-2.0-or-later

if BOARD_HUANANZHI_X99_QD4

config BOARD_SPECIFIC_OPTIONS
	def_bool y
	select BOARD_ROMSIZE_KB_16384
	select CPU_INTEL_HASWELL
	select HAVE_ACPI_RESUME
	select HAVE_ACPI_TABLES
	select NORTHBRIDGE_INTEL_HASWELL
	select SERIRQ_CONTINUOUS_MODE
	select SOUTHBRIDGE_INTEL_LYNXPOINT
	select SUPERIO_NUVOTON_NCT5539D # nct5532d in fact

config MAINBOARD_DIR
	default "huananzhi/x99-qd4"

config MAINBOARD_PART_NUMBER
	default "X99-QD4"

config MAX_CPUS
	int
	default 44

endif
```
